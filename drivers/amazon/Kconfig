## drivers/amazon/Kconfig
```kconfig
config AMAZON_MT76X3_MODULES
	bool "Amazon's MT7663 Wi-Fi and Bluetooth modules"
	depends on MODULES && CFG80211
	help
	  Builds wlan_mt76x3_sdio.ko, wlan_mt76x3_sdio_prealloc.ko and
	  btmtksdio.ko from drivers/amazon for the Echo Show 8 (2nd gen).
```

## drivers/misc/motion_controller/Kconfig
```kconfig
comment "motion controller module"

config MOTION_CONTROL
	tristate "Motion control support"
	depends on SPI
	help
	  An Motion Control module for Theia. Say Y when you want to support this tool.
```
