/*
 * Copyright (C) 2020 MediaTek Inc.
 *
 * This program is free software; you can redistribute it and/or modify
 * it under the terms of the GNU General Public License version 2 as
 * published by the Free Software Foundation.
 *
 * This program is distributed in the hope that it will be useful,
 * but WITHOUT ANY WARRANTY; without even the implied warranty of
 * MERCHANTABILITY or FITNESS FOR A PARTICULAR PURPOSE.  See the
 * GNU General Public License for more details.  */


#include "athena.dtsi"
#include <dt-bindings/clock/mt8183-clk.h>

/ {
	compatible = "amzn,athena-evt", "amzn,athena";

	aliases {
		mute_led_pwm = &pwm;
	};
};

&pwm {
	muteled-enable-two-point-cal;
	invert;
};
